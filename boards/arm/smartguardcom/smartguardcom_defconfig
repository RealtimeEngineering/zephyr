## boards/arm/smartguardcom/smartguardcom_defconfig
```kconfig
# SPDX-License-Identifier: Apache-2.0

CONFIG_SOC_SERIES_STM32H7X=y
CONFIG_SOC_STM32H743XX=y

# Enable MPU
CONFIG_ARM_MPU=y

# Enable HW stack protection
CONFIG_HW_STACK_PROTECTION=y

# Enable UART
CONFIG_SERIAL=y

# Console
CONFIG_CONSOLE=y
CONFIG_UART_CONSOLE=y

# Enable Pinmux
CONFIG_PINMUX=y

# Enable GPIO
CONFIG_GPIO=y

# Enable Clock
CONFIG_CLOCK_CONTROL=y

# Use MCO2 as ethernet phy 25MHz clock source
CONFIG_CLOCK_STM32_MCO2_SRC_SYSCLK=n
CONFIG_CLOCK_STM32_MCO2_SRC_PLL2P=y
CONFIG_CLOCK_STM32_MCO2_DIV=1
```
